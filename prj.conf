## CMakeLists.txt
```
#
# Copyright (c) 2018 Nordic Semiconductor
#
# SPDX-License-Identifier: LicenseRef-BSD-5-Clause-Nordic
#

cmake_minimum_required(VERSION 3.13.1)

set(spm_CONF_FILE ${CMAKE_CURRENT_SOURCE_DIR}/spm.conf)


set(PM_STATIC_YML_FILE
  ${CMAKE_CURRENT_SOURCE_DIR}/configuration/${BOARD}/pm_static.yml
  )

find_package(Zephyr REQUIRED HINTS $ENV{ZEPHYR_BASE})
project(mqtt_google_cloud)

zephyr_compile_definitions(PROJECT_NAME=${PROJECT_NAME})
zephyr_compile_definitions(_POSIX_C_SOURCE=200809L)

if(NOT EXISTS ${APPLICATION_SOURCE_DIR}/src/private_info/key.c)
    message(FATAL_ERROR "!!!!!! Generate key file before continuing !!!!!!")
endif()

# NORDIC SDK APP START
target_sources(app PRIVATE src/main.c)
target_sources(app PRIVATE src/gcloud.c)
target_sources(app PRIVATE src/cJSON.c)
target_sources(app PRIVATE src/private_info/key.c)
# NORDIC SDK APP END
zephyr_include_directories(src)

# Include application events and configuration headers
zephyr_library_include_directories(
  include
  src/env_sensors
  src/watchdog
  )

# Application sources
add_subdirectory(src/env_sensors)
add_subdirectory(src/watchdog)

if (CONFIG_USE_BME680_BSEC)
  target_link_libraries(app PUBLIC bsec_lib)
endif()

# Get git tag
exec_program(
  "git"
  ${CMAKE_CURRENT_SOURCE_DIR}
  ARGS "describe --abbrev=4 --dirty --always --tags"
  OUTPUT_VARIABLE GIT_TAG )

# If tag not found get the SHA1 hash instead
if( ${GIT_TAG} MATCHES "fatal:.*" )
exec_program(
  "git"
  ${CMAKE_CURRENT_SOURCE_DIR}
  ARGS "rev-parse HEAD"
  OUTPUT_VARIABLE GIT_VERSION )
else()
  set( GIT_VERSION ${GIT_TAG} )
endif()
add_definitions( -DAPP_GIT_VERSION="${GIT_VERSION}")
```

## Kconfig
```
config GCLOUD_PROJECT_NAME
    string "Name of the Google Cloud project"

config GCLOUD_REGION
    string "Google cloud region"

config GCLOUD_REGISTRY_NAME
    string "Name of the Google Cloud reigstry of the device"

config GCLOUD_DEVICE_NAME
    string "Name of the device in Google Cloud"
          

config DATE_TIME_UPDATE_INTERVAL_SECONDS
    int "Date time update interval, in seconds"
    default 10

config GCLOUD_WATCHDOG_TIMEOUT_MSEC
    int "Watchdog timeout in milliseconds"
    default 10000
    
menuconfig DATE_TIME
    bool "Date time library"
    select AT_CMD
    select SNTP
    depends on BSD_LIBRARY

menu "Environment sensors"

    config TEMP_DEV_NAME
        string "Temperature device name"
        help
            Device from which temperature data will be fetched and
            sent to nRF Cloud.

    config USE_BME680_BSEC
        bool "Use Bosch BME680 BSEC lib"
        default y
        help
            Enable use of Bosch BSEC library. The library itself is not a part of
            NCS and must be downloaded from Bosch Sensortec.
    
    config BOSCH_BSEC_LIBRARY_PATH
        string "Path to Bosch BSEC library folder"
        default "$(ZEPHYR_BASE)/../nrf/ext/BSEC_1.4.7.4_Generic_Release"
        help
            Path to the folder where the Bosch BSEC library is placed.

    config ENVIRONMENT_DATA_SEND_INTERVAL
        int "Interval in seconds for sending environment data"
        default 30
        help
            Interval between each sampling and sending of environment sensor data.
            If the GPS is active, sensor data will not be sent before it is
            stopped. The unit is seconds.
    
    config ENVIRONMENT_DATA_BACKOFF_TIME
        int "Time to delay sending environment data if GPS active"
        default 20
        help
            Time in seconds before retrying to send environment sensor data if
            the GPS is active.

endmenu # Environment sensors

config PRINTK
    bool "Send printk() to console"
    default y
    help
        This option directs printk() debugging output to the supported
        console device, rather than suppressing the generation
        of printk() output entirely. Output is sent immediately, without
        any mutual exclusion or buffering.


config MQTT_MESSAGE_BUFFER_SIZE
    int "MQTT message buffer size"
    default 256

config MQTT_PAYLOAD_BUFFER_SIZE
    int "MQTT payload buffer size"
    default 256

config GCLOUD_LOG_LEVEL
    int "App log level"
    default 4
        
# Include Zephyr's Kconfig
source "$ZEPHYR_BASE/Kconfig"
```

## prj.conf
```kconfig
# App config
CONFIG_GCLOUD_LOG_LEVEL=4
CONFIG_WATCHDOG=y
CONFIG_ASSERT=y
CONFIG_REBOOT=y

# General config
CONFIG_NEWLIB_LIBC_FLOAT_PRINTF=y
CONFIG_NEWLIB_LIBC=y

# Debug settings
CONFIG_SERIAL=n
CONFIG_LOG=n
CONFIG_LOG_PRINTK=n
CONFIG_LOG_IMMEDIATE=y
CONFIG_LOG_DEFAULT_LEVEL=4
# CONFIG_LOG_BACKEND_SHOW_COLOR=y
# CONFIG_LOG_BACKEND_UART=y
# CONFIG_LOG_BACKEND_RTT=n

# # Optimisation
# CONFIG_NO_OPTIMIZATIONS=y
# CONFIG_DEBUG=y

# Expand logging memory to avoid log_strdup() errors
CONFIG_LOG_STRDUP_MAX_STRING=256
CONFIG_LOG_STRDUP_BUF_COUNT=12

# LTE link control
CONFIG_LTE_LINK_CONTROL=y
CONFIG_LTE_AUTO_INIT_AND_CONNECT=n
# CONFIG_LTE_LINK_CONTROL_LOG_LEVEL_DBG=y

CONFIG_LTE_NETWORK_MODE_NBIOT=y
CONFIG_LTE_NETWORK_USE_FALLBACK=n

CONFIG_LTE_LEGACY_PCO_MODE=n
CONFIG_LTE_PSM_REQ_RPTAU="00000110"
CONFIG_LTE_PSM_REQ_RAT="00000010"
# CONFIG_LTE_PSM_REQ_RPTAU="10100000"
# CONFIG_LTE_PSM_REQ_RAT="11100000"

# BSD library
CONFIG_BSD_LIBRARY=y
CONFIG_DATE_TIME=y
CONFIG_DATE_TIME_MODEM=y
CONFIG_DATE_TIME_UPDATE_INTERVAL_SECONDS=3600
CONFIG_LEGACY_TIMEOUT_API=y
CONFIG_SNTP=y
CONFIG_FP_HARDABI=y
# CONFIG_DATE_TIME_LOG_LEVEL_DBG=y

# Disable Modem traces, since we need UART1 for HCI
CONFIG_BSD_LIBRARY_TRACE_ENABLED=n

# Networking
CONFIG_NETWORKING=y
CONFIG_NET_NATIVE=y
# CONFIG_NET_LOG=y

CONFIG_NET_SOCKETS=y
CONFIG_NET_SOCKETS_OFFLOAD=y
CONFIG_NET_SOCKETS_POSIX_NAMES=y
# CONFIG_NET_SOCKETS_LOG_LEVEL_DBG=y

CONFIG_NET_IPV4=y
CONFIG_NET_IPV6=n
CONFIG_NET_TCP=y
CONFIG_NET_UDP=y

# nRF9160 helper libraries
CONFIG_MODEM_KEY_MGMT=y
CONFIG_DNS_RESOLVER=y
CONFIG_MODEM_INFO=y

# Main thread
CONFIG_MAIN_THREAD_PRIORITY=7
CONFIG_UART_INTERRUPT_DRIVEN=y

# Google Cloud
CONFIG_GCLOUD_REGION="europe-west1"
CONFIG_GCLOUD_PROJECT_NAME="safecility-iot-dev"
CONFIG_GCLOUD_REGISTRY_NAME="iot-dev-registry"
CONFIG_GCLOUD_DEVICE_NAME="home-test1"

# JSON
CONFIG_JSON_LIBRARY=y

# JWT
CONFIG_JWT=y
CONFIG_JWT_SIGN_ECDSA=y

# MQTT
CONFIG_MQTT_LIB=y
CONFIG_MQTT_LIB_TLS=y
CONFIG_MQTT_MESSAGE_BUFFER_SIZE=1024
CONFIG_MQTT_PAYLOAD_BUFFER_SIZE=1024

# Set the PDP context
CONFIG_LTE_PDP_CMD=y
CONFIG_LTE_PDP_CONTEXT="0,\"IPv4\",\"arkessalp.com\""

# Enable PDN management
CONFIG_PDN_MANAGEMENT=y
CONFIG_LTE_PDN_AUTH_CMD=y
CONFIG_LTE_PDN_AUTH="0,\"PAP\",\"arkessa\",\"arkessa\""

# Heap and stacks
CONFIG_HEAP_MEM_POOL_SIZE=16384
CONFIG_MAIN_STACK_SIZE=8192
CONFIG_SYSTEM_WORKQUEUE_STACK_SIZE=2048
CONFIG_HW_STACK_PROTECTION=y

# Sensors
CONFIG_SENSOR=y
CONFIG_TEMP_DEV_NAME="BME680"
CONFIG_I2C_0=y

# Deselect CONFIG_BME680 if CONFIG_USE_BME680_BSEC is selected
CONFIG_BME680=n
CONFIG_USE_BME680_BSEC=y

# Enable settings storage
CONFIG_SETTINGS=y

# # AT Host
# CONFIG_UART_INTERRUPT_DRIVEN=y
# CONFIG_AT_HOST_LIBRARY=y

# # AT Command driver interface with Modem
# CONFIG_AT_CMD=y
# CONFIG_AT_CMD_PARSER=y
# CONFIG_MODEM_INFO_BUFFER_SIZE=512

# # Console
# CONFIG_CONSOLE_SUBSYS=y
# CONFIG_CONSOLE_HANDLER=y
# CONFIG_CONSOLE_GETCHAR=y
# CONFIG_CONSOLE=y
# CONFIG_STDOUT_CONSOLE=y
# CONFIG_UART_CONSOLE=y
```

## spm.conf
```kconfig
# Configuration copied from the nRF Secure Partition Manager (SPM) sample:
CONFIG_IS_SPM=y
CONFIG_FW_INFO=y
CONFIG_GPIO=n

# Make watchdog timers non-secure (so they can be used in the non-secure image).
CONFIG_SPM_NRF_WDT_NS=y
```

## src/main.c
```c
/*
 * Copyright (c) 2020 Safecility.com
 * Author: tad@safecility.com
 */

#include <zephyr.h>
#include <device.h>

#include <stdio.h>
#include <stdlib.h>
#include <string.h>
#include <errno.h>

#include <power/reboot.h>

#include <bsd.h>
#include <modem/lte_lc.h>
#include <modem/modem_info.h>

#include <nrf_socket.h>
#include <net/socket.h>
#include <net/mqtt.h>

#include <date_time.h>
#include <gcloud.h>
#include <cJSON.h>
#include <env_sensors/env_sensors.h>
#include <watchdog/watchdog.h>

#define CONFIG_APPLICATION_WORKQUEUE_PRIORITY 7

/* Size of buffer determines update rate */
#define DATA_ARRAY_SIZE 240 
#define SAMP_FREQ 33
#define THREAD_INDEX DATA_ARRAY_SIZE-2
#define REBOOT_TIMEOUT 20000
#define EXCLUDE 999

#define IAQ_STABILISING 0
#define IAQ_UNCERTAIN 1
#define IAQ_CALIBRATING 2
#define IAQ_CALIBRATED 3

/* Register main module log */
LOG_MODULE_REGISTER(google_mqtt, CONFIG_GCLOUD_LOG_LEVEL);

/* Info */
static const char* device_fw_ver = APP_GIT_VERSION;

/* Stack definition for application */
static K_THREAD_STACK_DEFINE(app_stack_area, 8192);
static K_THREAD_STACK_DEFINE(env_sens_stack_area, 8192);
static K_THREAD_STACK_DEFINE(data_ag_stack_area, 8192);
static K_THREAD_STACK_DEFINE(gc_stack_area, 4096);
static K_THREAD_STACK_DEFINE(ntp_stack_area, 512);
static K_THREAD_STACK_DEFINE(wdt_stack_area, 512);

/* Work Queues */
static struct k_work_q env_sens_q;
static struct k_work_q app_work_q;

/* Threads */
static struct k_thread ntp_thread;
static struct k_thread data_ag_thread;
static struct k_thread app_thread;
static struct k_thread gc_thread;

k_tid_t ntp_tid;
k_tid_t d_ag_tid;
k_tid_t app_tid;
k_tid_t gc_tid;

/* Normal env data */
struct env_data_t {
    s32_t t;
    s32_t h;
    s32_t p;
    s32_t q;
    u8_t a;
} env_d;

/* Aggregated env data type */
struct ag_data_t {
    s32_t max;
    s32_t min;
    s32_t avg;
    s32_t cnt;
} ag_d;

/* Packed struct */
struct pac_data_t {
    struct ag_data_t ag_temp;
    struct ag_data_t ag_humi;
    struct ag_data_t ag_pres;
    struct ag_data_t ag_qual;
} p_d;

struct m_info_t {
    char cid[30];
    char tac[30];
    char rssi[30];
    char apn[60];
    char fwv[60];
    uint16_t vltg;
    uint16_t temp;
};

/* Mailbox */
struct k_mbox env_d_mailbox;

/* Initialise Message Queues */
char __aligned(4) (env_msgq_buffer[10 * 36]);
struct k_msgq env_msg_q;

/* Global Flags */
volatile bool got_ntp = false;

/* Global Variables */

/* Forward declarations of functions */
static void store_modem_configuration(void);
static void env_data_ready(void);


/* Get average value of array */
s32_t calculate_avg_val(s32_t a[], s32_t sz, bool is_qual, s32_t * val_cnt)
{
    s32_t sum = 0;
    s32_t excl_cnt = 0;

    for(s32_t i=0; i<sz; i++) {
        if (!is_qual) {
            sum += a[i];
        } else if (is_qual && a[i] != EXCLUDE) {
            sum += a[i];
        } else {
            excl_cnt += 1;
        }
    }
    (*val_cnt) = (sz-excl_cnt);
    
    if (excl_cnt == sz) {
        return (EXCLUDE);
    } else {
        return (sum/(sz-excl_cnt));
    }
}


/* Get min value of array */
s32_t calculate_min_val(s32_t a[],s32_t sz)
{
    s32_t min, i;
    s32_t excl_cnt = 0;

 	min=a[0];
 	
    for(i=0; i<sz; i++) {
        if(min>a[i]) {
            min=a[i];  
        } 
    }
    return min;
}


/* Get max value of array */
s32_t calculate_max_val(s32_t a[],s32_t sz, bool is_qual)
{
 	s32_t max,i;
    s32_t excl_cnt = 0;

    max=a[0];
    
    for(i=0; i<sz; i++) 
    {
        if (is_qual) {
            if(max==EXCLUDE || max<a[i]) {
                max=a[i];   
            }
        } else {
            if(max<a[i]) {
                max=a[i];   
            }
        }
    }
    return max;
}


/* Handlers */
void button_handler(u32_t button_state, u32_t has_changed)
{
    LOG_INF("Button event: %x  %x\n", button_state, has_changed);
    if ( (has_changed & 0x01) && (button_state & 0x01) ) {
        store_modem_configuration();
    }
}


/**@brief Handler for when receiving data from Google Cloud */ 
void received_config_handler(const struct mqtt_publish_message *message) {

	cJSON * data_json = cJSON_Parse(message->payload.data);
	cJSON_Delete(data_json);
}


/**@brief Configures modem to provide LTE link. Blocks until link is
 * successfully established
 */
static void modem_configure(void)
{
    if (IS_ENABLED(CONFIG_LTE_AUTO_INIT_AND_CONNECT)) {
    /* Do nothing, modem is already turned on and connected */
    } else {
        int err;

        LOG_INF("Enabling PSM\n");
        /* Enable PSM mode */
        lte_lc_psm_req(true);

        LOG_INF("Establishing LTE link\n");
        err = lte_lc_init_and_connect();
        __ASSERT(err == 0, "LTE link could not be established. Rebooting\n");
    }
}


/**@brief Configures AT Command interface to the modem link. */
static void at_configure(void)
{
	int err;
	err = at_notif_init();
	__ASSERT(err == 0, "AT Notify could not be initialized.");
	err = at_cmd_init();
	__ASSERT(err == 0, "AT CMD could not be established.");
}


/**@brief Soft boots modem to store current values to NVM */
void store_modem_configuration(void)
{
    int err;

    LOG_INF("Storing modem configuration\n");
    err = lte_lc_power_off();
    if (err) {
        LOG_INF("Fail turning off modem: %d\n", err);
    }
    LOG_INF("Modem offline, turning back on\n");

    err = lte_lc_normal();
    if (err) {
        LOG_INF("Fail turning on modem: %d\n", err);
    }
    LOG_INF("Done\n");
}


/**@brief Return modem information */
void get_modem_info(struct m_info_t *info) 
{
    LOG_INF("Getting modem info\n");
    modem_info_string_get(MODEM_INFO_CELLID, info->cid, sizeof(info->cid));
    modem_info_string_get(MODEM_INFO_AREA_CODE, info->tac, sizeof(info->tac));
    modem_info_string_get(MODEM_INFO_RSRP, info->rssi, sizeof(info->rssi));
    modem_info_string_get(MODEM_INFO_APN, info->apn, sizeof(info->apn));
    modem_info_string_get(MODEM_INFO_FW_VERSION, info->fwv, sizeof(info->fwv));
	modem_info_short_get(MODEM_INFO_BATTERY, &info->vltg);
    modem_info_short_get(MODEM_INFO_TEMP, &info->temp);
}


/**@brief Store sensor data - process once full and
* initialise Google cloud thread
*/
void process_env_data(void) 
{
    int err;
    bool thread_started = false;

    u32_t buffer_bytes_used;
    u32_t run_count = 0;

    s32_t tempArray [DATA_ARRAY_SIZE];
    s32_t humiArray [DATA_ARRAY_SIZE];
    s32_t presArray [DATA_ARRAY_SIZE];
    s32_t qualArray [DATA_ARRAY_SIZE];

    struct env_data_t d_temp;
    struct pac_data_t pac_data;
    
    struct k_mbox_msg send_env_msg;

    while (true)
    {
        /* Get data and store - for size of array */
        for (int i = 0; i < DATA_ARRAY_SIZE; i++)
        {
            /* Pull data from queue */
            LOG_DBG("Getting environmental data: [%d] of [%d]", i, DATA_ARRAY_SIZE);
            k_msgq_get(&env_msg_q, &d_temp, K_FOREVER);

            tempArray[i] = (s32_t)d_temp.t;
            humiArray[i] = (s32_t)d_temp.h;
            presArray[i] = (s32_t)d_temp.p;

            /* Guard qual array from spurious readings */
            if (d_temp.a != IAQ_STABILISING) {
                qualArray[i] = (s32_t)d_temp.q; // fill array with valid readings
            } else {
               qualArray[i] = EXCLUDE;  // fill array with magic number
            }

            /* Increment data getter counter */
            run_count +=1;
            LOG_INF("Run Count: [%d]\n", run_count);

            if (!thread_started) {
                LOG_INF("[%d] samples to Google thread entry\n", ((THREAD_INDEX) - run_count));
            }

            /* If sufficient data collected start google thread */
            if ((run_count == (THREAD_INDEX)) && (!thread_started))
            {
                thread_started = true;
                run_count = 0;
                /* Provision Google Cloud Security Creds */
                LOG_INF("Provisioning\n");
                err = gcloud_provision();
                if (err) {
                    LOG_ERR("Failed to provision: %d\n", err);
                    /* Reboot */
                    sys_reboot(0); //TODO: Handle error
                } else {
                    LOG_INF("Provisioning complete\n");
                }

                /* Connect to Google Cloud */
                LOG_INF("Connecting to Google Cloud\n");
                err = gcloud_connect(received_config_handler);
                if (err) {
                    LOG_ERR("Failed to connect to Google Cloud, error: %d\n", err);
                    /* Reboot */
                    sys_reboot(0); //TODO: Handle error
                } else {
                    LOG_INF("Connected to Google Cloud\n");
                }
            }
        }

        /* Calculate data mean */
        LOG_INF("Calculating environmental data type avg");
        pac_data.ag_temp.avg = calculate_avg_val(tempArray, DATA_ARRAY_SIZE, false, &pac_data.ag_qual.cnt);
        pac_data.ag_humi.avg = calculate_avg_val(humiArray, DATA_ARRAY_SIZE, false, &pac_data.ag_qual.cnt);
        pac_data.ag_pres.avg = calculate_avg_val(presArray, DATA_ARRAY_SIZE, false, &pac_data.ag_qual.cnt);
        pac_data.ag_qual.avg = calculate_avg_val(qualArray, DATA_ARRAY_SIZE, true, &pac_data.ag_qual.cnt);
        LOG_INF("Mean temp: %d", (s32_t)pac_data.ag_temp.avg);
        LOG_INF("Mean humi: %d", (s32_t)pac_data.ag_humi.avg);
        LOG_INF("Mean pres: %d", (s32_t)pac_data.ag_pres.avg);
        LOG_INF("Mean qual: %d", (s32_t)pac_data.ag_qual.avg);
        LOG_INF("Valid IAQ reading count: %d", (s32_t)pac_data.ag_qual.cnt);

        /* Calculate data min */
        LOG_INF("Calculating environmental data type min");
        pac_data.ag_temp.min = calculate_min_val(tempArray, DATA_ARRAY_SIZE);
        pac_data.ag_humi.min = calculate_min_val(humiArray, DATA_ARRAY_SIZE);
        pac_data.ag_pres.min = calculate_min_val(presArray, DATA_ARRAY_SIZE);
        pac_data.ag_qual.min = calculate_min_val(qualArray, DATA_ARRAY_SIZE);
        LOG_INF("Min temp: %d", (s32_t)pac_data.ag_temp.min);
        LOG_INF("Min humi: %d", (s32_t)pac_data.ag_humi.min);
        LOG_INF("Min pres: %d", (s32_t)pac_data.ag_pres.min);
        LOG_INF("Min qual: %d", (s32_t)pac_data.ag_qual.min);

        /* Calculate data max */
        LOG_INF("Calculating environmental data type max");
        pac_data.ag_temp.max = calculate_max_val(tempArray, DATA_ARRAY_SIZE, false);
        pac_data.ag_humi.max = calculate_max_val(humiArray, DATA_ARRAY_SIZE, false);
        pac_data.ag_pres.max = calculate_max_val(presArray, DATA_ARRAY_SIZE, false);
        pac_data.ag_qual.max = calculate_max_val(qualArray, DATA_ARRAY_SIZE, true);
        LOG_INF("Max temp: %d", (s32_t)pac_data.ag_temp.max);
        LOG_INF("Max humi: %d", (s32_t)pac_data.ag_humi.max);
        LOG_INF("Max pres: %d", (s32_t)pac_data.ag_pres.max);
        LOG_INF("Max qual: %d", (s32_t)pac_data.ag_qual.max);

        /* Callback to Google Cloud Thread */
        LOG_INF("Sending data to google iot thread");
        buffer_bytes_used = sizeof(p_d);   //TODO: test that size is correct

        /* Prepare to send message */
        send_env_msg.info = buffer_bytes_used;
        send_env_msg.size = buffer_bytes_used;
        send_env_msg.tx_data = &pac_data;
        send_env_msg.tx_block.data = NULL;
        send_env_msg.tx_target_thread = K_ANY;

        /* Send message and wait until a consumer receives it */
        k_mbox_put(&env_d_mailbox, &send_env_msg, K_FOREVER);

        /* Verify that message data was fully received */
        if (send_env_msg.size < buffer_bytes_used) {
            LOG_DBG("env msg RXer only had room for [%d] bytes", send_env_msg.info);
        }
    }
}


/**@brief Environmental sensor data ready callback */
static void env_data_ready(void)
{
    env_sensor_data_t temp, humi, pres, qual;
    struct env_data_t env_data;

    LOG_INF("env sens data ready");

    /* Get sensor data and push to queue */
    if (! env_sensors_get_temperature(&temp)) {
        (env_data.t) = (s32_t)temp.value;
    }
    if (! env_sensors_get_humidity(&humi)) {
        (env_data.h) = (s32_t)humi.value;
    }
    if (! env_sensors_get_pressure(&pres)) {
        (env_data.p) = (s32_t)pres.value;
    }
    if (! env_sensors_get_air_quality(&qual)) {
        (env_data.q) = (s32_t)qual.value;
        (env_data.a) = (u8_t)qual.accuracy;
    }

    /* Send data to main thread */
    k_msgq_put(&env_msg_q, &env_data, K_NO_WAIT); //TODO: Is flushing the desired behaviour?
}


/**@brief Initializes environmental sensor object */
void init_env_sensor(void)
{
    int err;

    LOG_INF("Sensor workqueue started\n");
	k_work_q_start(&env_sens_q, env_sens_stack_area,
		    K_THREAD_STACK_SIZEOF(env_sens_stack_area),
		    CONFIG_APPLICATION_WORKQUEUE_PRIORITY);

    LOG_INF("Initializing environmental sensor\n");
    err = env_sensors_init_and_start(&env_sens_q, env_data_ready);
    if (err) {
        LOG_INF("environmental sensor initialization failed [%d]\n", err);
    }
    else {
        LOG_INF("environmental sensor initialized\n");
    }
}


/**@brief Poll for ntp timestamp */
int ntp_poll(void)
{
    s64_t date_time_stamp;

    // TODO: Add max try count
    while (date_time_now(&date_time_stamp) != 0)
    {
        LOG_ERR("Couldn't get time\n");
        k_sleep(K_MSEC(10000));
    }
    got_ntp = true;
    return 0;
}


/**@brief Main Processing Thread */
void app_gc_iot(void)
{
    bool sent_once = false;

    struct pac_data_t pac_data;
    struct m_info_t info;

    struct k_mbox_msg env_d_recv_msg;

    /* Block until time avail */
    while (!got_ntp) 
    {   
        LOG_INF("Waiting on Modem Time\n");
        k_sleep(K_MSEC(10000));
    }
    
    while(true) {
        /*
        * CAUTION! - cJSON allocs memory - ensure dealloced when done
        */
        
        /* Prepare to receive message from producer */
        env_d_recv_msg.info = 256;
        env_d_recv_msg.size = sizeof(pac_data);
        env_d_recv_msg.rx_source_thread = K_ANY; //TODO: Get producer thread id

        /* Get data from mailbox - blocking */
        LOG_DBG("App thread waiting for data from producer\n");
        k_mbox_get(&env_d_mailbox, &env_d_recv_msg, &pac_data, K_FOREVER);

        /* Verify that message data was fully received */
        if (env_d_recv_msg.info != env_d_recv_msg.size) {
            LOG_INF("Sender tried to send [%d] bytes\n", env_d_recv_msg.info);
        } else {
            LOG_INF("Received k_mbox\n");
        }

        /* Get modem information */
        get_modem_info(&info);
        LOG_INF("Voltage: [%d]\n", info.vltg);
        LOG_INF("Temp: [%d]\n", info.temp);
    
        /* Create cJSON object */
        cJSON * envSensObj = cJSON_CreateObject();

        /* Create cJSON strings */
        const char * jCidString = "cid";
        const char * jTacString = "tac";
        const char * jRssiString = "rssi";
        const char * jApnString = "apn";
        const char * jFwvString = "mfwv";
        const char * jVltgString = "vltg";
        const char * jTempString = "itemp";
        cJSON *jCid = NULL;
        cJSON *jTac = NULL;
        cJSON *jRssi = NULL;
        cJSON *jApn = NULL;
        cJSON *jFwv = NULL;
        cJSON *jVltg = NULL;
        cJSON *jTemp = NULL;

        const char * jDevFwvString = "dfwv";
        cJSON *jDvFwv = NULL;

        const char * jTempMaxString = "tempMax";
        const char * jHumiMaxString = "humiMax";
        const char * jPresMaxString = "presMax";
        const char * jQualMaxString = "qualMax";
        cJSON *jTempMax = NULL;
        cJSON *jHumiMax = NULL;
        cJSON *jPresMax = NULL;
        cJSON *jQualMax = NULL;

        const char * jTempMinString = "tempMin";
        const char * jHumiMinString = "humiMin";
        const char * jPresMinString = "presMin";
        const char * jQualMinString = "qualMin";
        cJSON *jTempMin = NULL;
        cJSON *jHumiMin = NULL;
        cJSON *jPresMin = NULL;
        cJSON *jQualMin = NULL;
        
        const char * jTempAvgString = "tempAvg";
        const char * jHumiAvgString = "humiAvg";
        const char * jPresAvgString = "presAvg";
        const char * jQualAvgString = "qualAvg";
        cJSON *jTempAvg = NULL;
        cJSON *jHumiAvg = NULL;
        cJSON *jPresAvg = NULL;
        cJSON *jQualAvg = NULL;

        const char * jSampSzString = "sampleSz";
        const char * jSampFrqString = "sampleFrq";
        const char * jQualCntString = "qualCnt";

        cJSON *jSampSz = NULL;
        cJSON *jSampFrq = NULL;
        cJSON *jQualCnt = NULL;

        const char * jQualCalString = "calibrated";
        cJSON *jQualCal = NULL;

        /* Initialise empty string */
        char * JSONEnvString = NULL;

        /* Create cJSON items */
        jTempMax = cJSON_CreateNumber((s32_t)pac_data.ag_temp.max);
        jTempMin = cJSON_CreateNumber((s32_t)pac_data.ag_temp.min);
        jTempAvg = cJSON_CreateNumber((s32_t)pac_data.ag_temp.avg);

        jHumiMax = cJSON_CreateNumber((s32_t)pac_data.ag_humi.max);
        jHumiMin = cJSON_CreateNumber((s32_t)pac_data.ag_humi.min);
        jHumiAvg = cJSON_CreateNumber((s32_t)pac_data.ag_humi.avg);

        jPresMax = cJSON_CreateNumber((s32_t)pac_data.ag_pres.max);
        jPresMin = cJSON_CreateNumber((s32_t)pac_data.ag_pres.min);
        jPresAvg = cJSON_CreateNumber((s32_t)pac_data.ag_pres.avg);

        jQualMax = cJSON_CreateNumber((s32_t)pac_data.ag_qual.max);
        jQualMin = cJSON_CreateNumber((s32_t)pac_data.ag_qual.min);
        jQualAvg = cJSON_CreateNumber((s32_t)pac_data.ag_qual.avg);

        /* IAQ calibration */
        if (pac_data.ag_qual.avg == EXCLUDE) {
            jQualCal = cJSON_CreateString("no");
        } else {
           jQualCal = cJSON_CreateString("yes"); 
        }
        
        jSampSz = cJSON_CreateNumber(DATA_ARRAY_SIZE);
        jSampFrq = cJSON_CreateNumber(SAMP_FREQ);

        jQualCnt = cJSON_CreateNumber((s32_t)pac_data.ag_qual.cnt);
        
        jCid = cJSON_CreateString((const char*)info.cid);
        jTac = cJSON_CreateString((const char*)info.tac);
        jRssi = cJSON_CreateString((const char*)info.rssi);
        jApn = cJSON_CreateString((const char*)info.apn);
        jFwv = cJSON_CreateString((const char*)info.fwv);
        jVltg = cJSON_CreateNumber((u16_t)info.vltg);
        jTemp = cJSON_CreateNumber((u16_t)info.temp);

        jDvFwv = cJSON_CreateString((const char*)device_fw_ver);

        /* Add cJSON items to object */
        cJSON_AddItemToObject(envSensObj, jTempMaxString, jTempMax);
        cJSON_AddItemToObject(envSensObj, jHumiMaxString, jHumiMax);
        cJSON_AddItemToObject(envSensObj, jPresMaxString, jPresMax);
        cJSON_AddItemToObject(envSensObj, jQualMaxString, jQualMax);

        cJSON_AddItemToObject(envSensObj, jTempMinString, jTempMin);
        cJSON_AddItemToObject(envSensObj, jHumiMinString, jHumiMin);
        cJSON_AddItemToObject(envSensObj, jPresMinString, jPresMin);
        cJSON_AddItemToObject(envSensObj, jQualMinString, jQualMin);

        cJSON_AddItemToObject(envSensObj, jTempAvgString, jTempAvg);
        cJSON_AddItemToObject(envSensObj, jHumiAvgString, jHumiAvg);
        cJSON_AddItemToObject(envSensObj, jPresAvgString, jPresAvg);
        cJSON_AddItemToObject(envSensObj, jQualAvgString, jQualAvg);

        cJSON_AddItemToObject(envSensObj, jSampSzString, jSampSz);
        cJSON_AddItemToObject(envSensObj, jSampFrqString, jSampFrq);

        cJSON_AddItemToObject(envSensObj, jCidString, jCid);
        cJSON_AddItemToObject(envSensObj, jTacString, jTac);
        cJSON_AddItemToObject(envSensObj, jRssiString, jRssi);
        cJSON_AddItemToObject(envSensObj, jApnString, jApn);
        cJSON_AddItemToObject(envSensObj, jFwvString, jFwv);
        cJSON_AddItemToObject(envSensObj, jVltgString, jVltg);
        cJSON_AddItemToObject(envSensObj, jTempString, jTemp);

        cJSON_AddItemToObject(envSensObj, jQualCntString, jQualCnt);
        cJSON_AddItemToObject(envSensObj, jQualCalString, jQualCal);

        cJSON_AddItemToObject(envSensObj, jDevFwvString, jDvFwv);

        /* Create JSON string from object */
        JSONEnvString = cJSON_Print(envSensObj);
        if (JSONEnvString == NULL) {
            LOG_DBG("Failed to print envSensObj\n");
        }

        /* Send JSON data */
        LOG_INF("Sending JSON data\n");
	    int pub_success = gcloud_publish(JSONEnvString, strlens(JSONEnvString), MQTT_QOS_0_AT_MOST_ONCE);
        LOG_INF("Sent JSON data with code: [%d]\n", pub_success);
        if (pub_success != 0) {
            LOG_INF("JSON data Publish failed\n");
        }

        /* Cleanup JSON obj - release memory */
        cJSON_Delete(envSensObj);

        /* Reboot */
        LOG_INF("Rebooting in [%d] seconds\n", REBOOT_TIMEOUT/1000);
        k_sleep(K_MSEC(REBOOT_TIMEOUT));
        LOG_INF("Rebooting\n");
        sys_reboot(0);
    }
    /* Is it correct to disconnect? */
    gcloud_disconnect();
    sys_reboot(0);
    
}


/**@brief Thread initialisation */
void main(void)
{
    LOG_INF("Google Cloud env sensor app started");

	k_work_q_start(&app_work_q, wdt_stack_area,
		       K_THREAD_STACK_SIZEOF(wdt_stack_area),
		       CONFIG_APPLICATION_WORKQUEUE_PRIORITY);
	if (IS_ENABLED(CONFIG_WATCHDOG)) {
		watchdog_init_and_start(&app_work_q);
	}

	LOG_INF("Initializing modem\n");
    modem_configure();

    LOG_INF("Initializing modem info\n");
    modem_info_init();

    LOG_INF("Initializing environmental sensor\n");
    init_env_sensor();

    LOG_INF("Initializing bsec data message queue\n");
    k_msgq_init(&env_msg_q, env_msgq_buffer, sizeof(env_d), 10);

    LOG_INF("Initializing aggregated data mailbox\n");
    k_mbox_init(&env_d_mailbox);

    /* Initialise data aggregation thread */
    d_ag_tid = k_thread_create(&data_ag_thread, data_ag_stack_area, K_THREAD_STACK_SIZEOF(data_ag_stack_area),
        (k_thread_entry_t)process_env_data, NULL, NULL, NULL,
        7, 0, K_NO_WAIT);

    /* Initialise time pool poll thread */
    ntp_tid = k_thread_create(&ntp_thread, ntp_stack_area, K_THREAD_STACK_SIZEOF(ntp_stack_area),
        (k_thread_entry_t)ntp_poll, NULL, NULL, NULL,
        7, 0, K_NO_WAIT);

    /* Initialise Google Cloud thread */
    gc_tid = k_thread_create(&gc_thread, gc_stack_area, K_THREAD_STACK_SIZEOF(gc_stack_area),
        (k_thread_entry_t)gcloud_thread, NULL, NULL, NULL,
        7, 0, K_NO_WAIT);

    /* Initialise App thread */
    app_tid = k_thread_create(&app_thread, app_stack_area, K_THREAD_STACK_SIZEOF(app_stack_area),
        (k_thread_entry_t)app_gc_iot, NULL, NULL, NULL,
        7, 0, K_NO_WAIT);
}
```

## include/cJSON.h
```c
/*
  Copyright (c) 2009 Dave Gamble
 

  Permission is hereby granted, free of charge, to any person obtaining a copy
  of this software and associated documentation files (the "Software"), to deal
  in the Software without restriction, including without limitation the rights
  to use, copy, modify, merge, publish, distribute, sublicense, and/or sell
  copies of the Software, and to permit persons to whom the Software is
  furnished to do so, subject to the following conditions:
 

  The above copyright notice and this permission notice shall be included in
  all copies or substantial portions of the Software.
 

  THE SOFTWARE IS PROVIDED "AS IS", WITHOUT WARRANTY OF ANY KIND, EXPRESS OR
  IMPLIED, INCLUDING BUT NOT LIMITED TO THE WARRANTIES OF MERCHANTABILITY,
  FITNESS FOR A PARTICULAR PURPOSE AND NONINFRINGEMENT. IN NO EVENT SHALL THE
  AUTHORS OR COPYRIGHT HOLDERS BE LIABLE FOR ANY CLAIM, DAMAGES OR OTHER
  LIABILITY, WHETHER IN AN ACTION OF CONTRACT, TORT OR OTHERWISE, ARISING FROM,
  OUT OF OR IN CONNECTION WITH THE SOFTWARE OR THE USE OR OTHER DEALINGS IN
  THE SOFTWARE.
*/

#ifndef cJSON__h
#define cJSON__h

#ifdef __cplusplus
extern "C" {
#endif

#include <stddef.h>

/* cJSON Types: */
#define cJSON_False 0
#define cJSON_True 1
#define cJSON_NULL 2
#define cJSON_Number 3
#define cJSON_String 4
#define cJSON_Array 5
#define cJSON_Object 6

#define cJSON_IsReference 256
#define cJSON_StringIsConst 512

#define strlens(s) (s==NULL?0:strlen(s))

/* The cJSON structure: */
typedef struct cJSON {
	struct cJSON *next, *prev; /* next/prev allow you to walk array/object
				      chains. Alternatively, use
				      GetArraySize/GetArrayItem/GetObjectItem */
	struct cJSON *child;       /* An array or object item will have a child
				      pointer pointing to a chain of the items in the
				      array/object. */

	int type; /* The type of the item, as above. */

	char *valuestring;  /* The item's string, if type==cJSON_String */
	int valueint;       /* The item's number, if type==cJSON_Number */
	double valuedouble; /* The item's number, if type==cJSON_Number */

	char *string; /* The item's name string, if this item is the child of,
			 or is in the list of subitems of an object. */
} cJSON;

typedef struct cJSON_Hooks {
	void *(*malloc_fn)(size_t sz);
	void (*free_fn)(void *ptr);
} cJSON_Hooks;

/* Supply malloc, realloc and free functions to cJSON */
extern void cJSON_InitHooks(cJSON_Hooks *hooks);


/* Supply a block of JSON, and this returns a cJSON object you can interrogate.
 * Call cJSON_Delete when finished. */
extern cJSON *cJSON_Parse(const char *value);
/* Render a cJSON entity to text for transfer/storage. Free the char* when
 * finished. */
extern char *cJSON_Print(cJSON *item);
/* Render a cJSON entity to text for transfer/storage without any formatting.
 * Free the char* when finished. */
extern char *cJSON_PrintUnformatted(cJSON *item);
/* Render a cJSON entity to text using a buffered strategy. prebuffer is a guess
 * at the final size. guessing well reduces reallocation. fmt=0 gives
 * unformatted, =1 gives formatted */
extern char *cJSON_PrintBuffered(cJSON *item, int prebuffer, int fmt);
/* Delete a cJSON entity and all subentities. */
extern void cJSON_Delete(cJSON *c);

/* Returns the number of items in an array (or object). */
extern int cJSON_GetArraySize(cJSON *array);
/* Retrieve item number "item" from array "array". Returns NULL if unsuccessful.
 */
extern cJSON *cJSON_GetArrayItem(cJSON *array, int item);
/* Get item "string" from object. Case insensitive. */
extern cJSON *cJSON_GetObjectItem(cJSON *object, const char *string);

/* For analysing failed parses. This returns a pointer to the parse error.
 * You'll probably need to look a few chars back to make sense of it. Defined
 * when cJSON_Parse() returns 0. 0 when cJSON_Parse() succeeds. */
extern const char *cJSON_GetErrorPtr(void);

/* These calls create a cJSON item of the appropriate type. */
extern cJSON *cJSON_CreateNull(void);
extern cJSON *cJSON_CreateTrue(void);
extern cJSON *cJSON_CreateFalse(void);
extern cJSON *cJSON_CreateBool(int b);
extern cJSON *cJSON_CreateNumber(double num);
extern cJSON *cJSON_CreateString(const char *string);
extern cJSON *cJSON_CreateArray(void);
extern cJSON *cJSON_CreateObject(void);

/* These utilities create an Array of count items. */
extern cJSON *cJSON_CreateIntArray(const int *numbers, int count);
extern cJSON *cJSON_CreateFloatArray(const float *numbers, int count);
extern cJSON *cJSON_CreateDoubleArray(const double *numbers, int count);
extern cJSON *cJSON_CreateStringArray(const char **strings, int count);

/* Append item to the specified array/object. */
extern void cJSON_AddItemToArray(cJSON *array, cJSON *item);
extern void cJSON_AddItemToObject(cJSON *object, const char *string,
				  cJSON *item);
extern void cJSON_AddItemToObjectCS(
	cJSON *object, const char *string,
	cJSON *item); /* Use this when string is definitely const (i.e. a
			 literal, or as good as), and will definitely survive
			 the cJSON object */
/* Append reference to item to the specified array/object. Use this when you
 * want to add an existing cJSON to a new cJSON, but don't want to corrupt your
 * existing cJSON. */
extern void cJSON_AddItemReferenceToArray(cJSON *array, cJSON *item);
extern void cJSON_AddItemReferenceToObject(cJSON *object, const char *string,
					   cJSON *item);

/* Remove/Detatch items from Arrays/Objects. */
extern cJSON *cJSON_DetachItemFromArray(cJSON *array, int which);
extern void cJSON_DeleteItemFromArray(cJSON *array, int which);
extern cJSON *cJSON_DetachItemFromObject(cJSON *object, const char *string);
extern void cJSON_DeleteItemFromObject(cJSON *object, const char *string);

/* Update array items. */
extern void cJSON_InsertItemInArray(
	cJSON *array, int which,
	cJSON *newitem); /* Shifts pre-existing items to the right. */
extern void cJSON_ReplaceItemInArray(cJSON *array, int which, cJSON *newitem);
extern void cJSON_ReplaceItemInObject(cJSON *object, const char *string,
				      cJSON *newitem);

/* Duplicate a cJSON item */
extern cJSON *cJSON_Duplicate(cJSON *item, int recurse);
/* Duplicate will create a new, identical cJSON item to the one you pass, in new
memory that will need to be released. With recurse!=0, it will duplicate any
children connected to the item. The item->next and ->prev pointers are always
zero on return from Duplicate. */

/* ParseWithOpts allows you to require (and check) that the JSON is null
 * terminated, and to retrieve the pointer to the final byte parsed. */
extern cJSON *cJSON_ParseWithOpts(const char *value,
				  const char **return_parse_end,
				  int require_null_terminated);

extern void cJSON_Minify(char *json);

/* Macros for creating things quickly. */
#define cJSON_AddNullToObject(object, name)                                    \
	cJSON_AddItemToObject(object, name, cJSON_CreateNull())
#define cJSON_AddTrueToObject(object, name)                                    \
	cJSON_AddItemToObject(object, name, cJSON_CreateTrue())
#define cJSON_AddFalseToObject(object, name)                                   \
	cJSON_AddItemToObject(object, name, cJSON_CreateFalse())
#define cJSON_AddBoolToObject(object, name, b)                                 \
	cJSON_AddItemToObject(object, name, cJSON_CreateBool(b))
#define cJSON_AddNumberToObject(object, name, n)                               \
	cJSON_AddItemToObject(object, name, cJSON_CreateNumber(n))
#define cJSON_AddStringToObject(object, name, s)                               \
	cJSON_AddItemToObject(object, name, cJSON_CreateString(s))

/* When assigning an integer value, it needs to be propagated to valuedouble
 * too. */
#define cJSON_SetIntValue(object, val)                                         \
	((object) ? (object)->valueint = (object)->valuedouble = (val) : (val))
#define cJSON_SetNumberValue(object, val)                                      \
	((object) ? (object)->valueint = (object)->valuedouble = (val) : (val))

#ifdef __cplusplus
}
#endif

#endif
```

## include/gcloud.h
```c
#ifndef __MQTT_H__
#define __MQTT_H__

#include <net/mqtt.h>

#define strlens(s) (s==NULL?0:strlen(s))

typedef void (*received_config_handler_t)(const struct mqtt_publish_message *message);

/**
 * @brief Publishes data to Google Cloud.
 * 
 * @param[in] data A pointer to the data to be sent.
 * @param[in] size The size of the data to be sent.
 * @param[in] qos The Quality of Serive level to be used when sending the telemetry.
 * 
 * @note Google Cloud does only support QoS 0 and QoS 1, not QoS 2
 * 
 * @retval 0 or an error code indicating reason for failure.
 */
// CANDO: Make it possible to publish gps to subtopics
int gcloud_publish(u8_t *data, u32_t size, enum mqtt_qos qos);

/**
 * @brief Publishes device state to Google Cloud.
 * 
 * @param[in] data A pointer to the data to be sent.
 * @param[in] size The size of the data to be sent.
 * @param[in] qos The Quality of service level to be used when sending the state.
 * 
 * @note Google Cloud does only support QoS 0 and QoS 1, not Qos 2.
 * @note Google Cloud limits state updates to 1 update per second, per device. 
 *       However, for best results, device state should be updated much less often 
 *       - at most, once every 10 second.
 * 
 * @retval 0 or an error code indicating reson for failure.
 */
int gcloud_publish_state(u8_t *data, u32_t size, enum mqtt_qos qos);

/**
 * @brief Connects the device to Google Cloud, and subscribes to Google Cloud's configuration topic.
 * 
 * @note gcloud_provision must be called before this.
 * @note Shall be called before trying to send data to Google Cloud.
 * @note The modem must be turned on, and connected before this function can be called.
 * 
 * @param[in] received_config_cb Callback function which will be called when a configuration 
 *            update is received from Google Cloud.
 * 
 * @retval - or an error code indicating reason for failure.
 */
// CANDO: make it possible to set keep-alive checks, and input check intervals
// CANDO: make it possible to decide what QoS level the subscription to config should be
int gcloud_connect(received_config_handler_t received_config_cb);

/**
 * @brief Initializes the module and provisions the modem so that an TLS 
 * connection can be established to Google Cloud.
 * 
 * @note Shall be called before the modem is turned on.
 * @note Shall be called before gcloud_connect.
 * @note If module initialization fails, no module APIs shall be called.
 * 
 * @retval 0 or an error code indicating reason for failure.
 */
int gcloud_provision(void);

/**
 * @brief Disconnects the device from Google Cloud.
 * 
 * @retval 0 or an error code indicating reason for failure.
 */
int gcloud_disconnect(void);

/**
 * @brief Google Cloud Thread entry.
 */
extern void gcloud_thread(void *unused1, void *unused2, void *unused3);

#endif /* __MQTT_H__ */
```
